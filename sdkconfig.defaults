## sdkconfig.defaults
```kconfig
CONFIG_BT_ENABLED=y
CONFIG_BT_BLE_ENABLED=y
CONFIG_BT_NIMBLE_ENABLED=y
# CONFIG_BT_BLUEDROID_ENABLED is not set

; XIAO ESP32C6 has 4MB flash. The app partition (2880K) + SPIFFS will not fit in 2MB.
CONFIG_ESPTOOLPY_FLASHSIZE_4MB=y
```
